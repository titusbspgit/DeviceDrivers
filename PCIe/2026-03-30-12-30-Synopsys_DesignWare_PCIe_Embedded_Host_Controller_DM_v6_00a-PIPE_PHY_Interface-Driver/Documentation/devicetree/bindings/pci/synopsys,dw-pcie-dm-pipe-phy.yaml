## PCIe/2026-03-30-12-30-Synopsys_DesignWare_PCIe_Embedded_Host_Controller_DM_v6_00a-PIPE_PHY_Interface-Driver/Documentation/devicetree/bindings/pci/synopsys,dw-pcie-dm-pipe-phy.yaml
```yaml
# SPDX-License-Identifier: (BSD-3-Clause OR GPL-2.0-only)
%YAML 1.2
---
$id: "http://devicetree.org/schemas/pci/synopsys,dw-pcie-dm-pipe-phy.yaml#"
$schema: "http://devicetree.org/meta-schemas/core.yaml#"

title: Synopsys DesignWare PCIe DM v6.00a External PIPE PHY Integration Shim

maintainers:
  - name: RCI-ag-DrvGen Agent
    email: devnull@example.com

properties:
  compatible:
    enum:
      - synopsys,dw-pcie-dm-pipe-phy

  reg:
    maxItems: 1

  clocks:
    minItems: 1
    items:
      - description: Reference clock for PHY/PIPE (e.g., 100MHz)
  clock-names:
    items:
      - const: refclk

  resets:
    minItems: 1
    items:
      - description: PMA reset
      - description: PIPE reset
  reset-names:
    items:
      - const: pma
      - const: pipe

  phys:
    maxItems: 1
  phy-names:
    items:
      - const: pcie-phy

  refclk-rate:
    description: Reference clock rate in Hz (e.g., 100000000)
    $ref: /schemas/types.yaml#/definitions/uint32

  ssc:
    type: boolean
    description: Enable spread-spectrum clocking

  pipe-version:
    description: Requested PIPE generation (e.g., 5)
    $ref: /schemas/types.yaml#/definitions/uint32

required:
  - compatible
  - reg

additionalProperties: false

examples:
  - |
    pcie_pipe: pcie-pipe@f9000000 {
      compatible = "synopsys,dw-pcie-dm-pipe-phy";
      reg = <0x0 0xf9000000 0x0 0x2000>;
      clocks = <&clk_ref>;
      clock-names = "refclk";
      resets = <&rstc 12>, <&rstc 13>;
      reset-names = "pma", "pipe";
      phys = <&pcie_serdes>;
      phy-names = "pcie-phy";
      refclk-rate = <100000000>;
      ssc;
      pipe-version = <5>;
    };
```
